## os/external/package/flutterpi/Config.in
```kconfig
config BR2_PACKAGE_FLUTTERPI
	bool "flutter-pi"
	depends on BR2_TOOLCHAIN_USES_GLIBC
	depends on BR2_INSTALL_LIBSTDCPP
	depends on BR2_TOOLCHAIN_HAS_THREADS
	depends on BR2_PACKAGE_HAS_LIBGLES
	depends on BR2_PACKAGE_HAS_LIBEGL
	depends on BR2_PACKAGE_HAS_LIBGBM
	depends on BR2_PACKAGE_SYSTEMD
	depends on BR2_PACKAGE_HAS_UDEV
	select BR2_PACKAGE_LIBDRM
	select BR2_PACKAGE_LIBINPUT
	select BR2_PACKAGE_LIBXKBCOMMON
	help
	  Light-weight Flutter engine embedder rendering straight to
	  KMS/DRM. No X11, no Wayland.

	  Unlike the in-tree buildroot flutter-pi package, this one does
	  NOT build the Flutter engine from source: flutter-pi dlopen()s
	  libflutter_engine.so at runtime, and that library ships inside
	  the app bundle produced by flutterpi_tool on the host.

	  https://github.com/ardera/flutter-pi

comment "flutter-pi needs a glibc toolchain w/ C++, threads, OpenGL ES, EGL, GBM, systemd, udev"
	depends on !BR2_TOOLCHAIN_USES_GLIBC || !BR2_INSTALL_LIBSTDCPP \
		|| !BR2_TOOLCHAIN_HAS_THREADS || !BR2_PACKAGE_HAS_LIBGLES \
		|| !BR2_PACKAGE_HAS_LIBEGL || !BR2_PACKAGE_HAS_LIBGBM \
		|| !BR2_PACKAGE_SYSTEMD || !BR2_PACKAGE_HAS_UDEV
```
